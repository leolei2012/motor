

#include "ntc_temp.h"

/** ─────────────────────────────────────────────
 * 查找表定义
 * 阻值从大到小（温度从低到高），单位 Ω，温度单位 0.1°C
 * ───────────────────────────────────────────── */

/** ── 100kΩ @ 25°C，B = 3950 ── */
const struct ntc_table_entry_t ntc_table_jxw3752[] = {
    /// {-500, 76},
    /// {-490, 79},
    /// {-480, 81},
    /// {-470, 83},
    /// {-460, 85},
    /// {-450, 88},
    /// {-440, 90},
    /// {-430, 93},
    /// {-420, 97},
    /// {-410, 101},
    /// {-400, 105},
    /// {-390, 110},
    /// {-380, 116},
    /// {-370, 122},
    /// {-360, 129},
    /// {-350, 136},
    /// {-340, 144},
    /// {-330, 153},
    /// {-320, 162},
    /// {-310, 172},
    /// {-300, 182},
    /// {-290, 193},
    /// {-280, 204},
    /// {-270, 216},
    /// {-260, 228},
    /// {-250, 241},
    /// {-240, 255},
    /// {-230, 269},
    /// {-220, 284},
    /// {-210, 299},
    /// {-200, 315},
    /// {-190, 332},
    /// {-180, 350},
    /// {-170, 368},
    /// {-160, 386},
    /// {-150, 406},
    /// {-140, 426},
    /// {-130, 447},
    /// {-120, 469},
    /// {-110, 492},
    /// {-100, 515},
    /// {-90, 540},
    {-80, 565},
    {-70, 591},
    {-60, 618},
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    {500, 2831},
    /// {510, 2864},
    /// {520, 2896},
    /// {530, 2928},
    /// {540, 2959},
    /// {550, 2989},
    /// {560, 3019},
    /// {570, 3048},
    /// {580, 3076},
    /// {590, 3104},
    /// {600, 3131},
    /// {610, 3157},
    /// {620, 3183},
    /// {630, 3208},
    /// {640, 3232},
    /// {650, 3256},
    /// {660, 3279},
    /// {670, 3301},
    /// {680, 3324},
    /// {690, 3345},
    /// {700, 3365},
    /// {710, 3386},
    /// {720, 3405},
    /// {730, 3425},
    /// {740, 3443},
    /// {750, 3461},
    /// {760, 3479},
    /// {770, 3496},
    /// {780, 3512},
    /// {790, 3529},
    /// {800, 3544},
    /// {810, 3559},
    /// {820, 3574},
    /// {830, 3589},
    /// {840, 3602},
    /// {850, 3616},
    /// {860, 3629},
    /// {870, 3642},
    /// {880, 3655},
    /// {890, 3666},
    /// {900, 3678},
    /// {910, 3690},
    /// {920, 3700},
    /// {930, 3711},
    /// {940, 3721},
    /// {950, 3732},
    /// {960, 3741},
    /// {970, 3751},
    /// {980, 3760},
    /// {990, 3769},
    /// {1000, 3778},
    /// {1010, 3786},
    /// {1020, 3794},
    /// {1030, 3803},
    /// {1040, 3810},
    /// {1050, 3818},
    /// {1060, 3825},
    /// {1070, 3832},
    /// {1080, 3839},
    /// {1090, 3846},
    /// {1100, 3852},
    /// {1110, 3858},
    /// {1120, 3864},
    /// {1130, 3870},
    /// {1140, 3876},
    /// {1150, 3882},
    /// {1160, 3887},
    /// {1170, 3892},
    /// {1180, 3897},
    /// {1190, 3902},
    /// {1200, 3906},
    /// {1210, 3911},
    /// {1220, 3916},
    /// {1230, 3920},
    /// {1240, 3924},
    /// {1250, 3929},

};
const uint16_t ntc_table_jxw3752_len = (uint16_t)(sizeof(ntc_table_jxw3752) / sizeof(ntc_table_jxw3752[0]));


/** ─────────────────────────────────────────────
 * 初始化
 * ───────────────────────────────────────────── */

int8_t ntc_init(struct ntc_handle_t *h, uint16_t adc_max, const struct ntc_table_entry_t *table, uint16_t table_len)
{
    if (h == NULL || table == NULL || table_len < 2)
    {
        return NTC_ERR_NULL;
    }

    h->adc_max = adc_max;
    h->table = table;
    h->table_len = table_len;

    h->_initialized = 1;

    return NTC_OK;
}

/** ─────────────────────────────────────────────
 * AD → 温度（二分查找 + 线性插值）
 * ───────────────────────────────────────────── */

int8_t ntc_ad_to_temp(const struct ntc_handle_t *h, uint16_t ad_raw, int16_t *temp_x10)
{
    const struct ntc_table_entry_t *tbl;
    uint16_t len;
    uint16_t lo, hi;
    uint16_t mid;
    uint8_t ascending;

    int32_t ad1;
    int32_t ad2;
    int32_t t1;
    int32_t t2;
    int32_t ad;
    int32_t delta_ad;

    if (h == NULL || temp_x10 == NULL || h->table == NULL || h->table_len < 2)
    {
        return NTC_ERR_NULL;
    }

    tbl = h->table;
    len = h->table_len;

    ascending = (tbl[0].ad < tbl[len - 1].ad) ? 1 : 0;

    /** 超出表范围检查 */
    if ((ascending && ad_raw < tbl[0].ad) || (!ascending && ad_raw > tbl[0].ad))
    {
        *temp_x10 = tbl[0].temp_x10;
        return NTC_ERR_TEMP_RANGE;
    }
    if ((ascending && ad_raw > tbl[len - 1].ad) || (!ascending && ad_raw < tbl[len - 1].ad))
    {
        *temp_x10 = tbl[len - 1].temp_x10;
        return NTC_ERR_TEMP_RANGE;
    }

    /// 二分查找
    lo = 0;
    hi = len - 1;
    while (hi - lo > 1)
    {
        mid = (lo + hi) >> 1;
        if ((ascending && tbl[mid].ad <= ad_raw) || (!ascending && tbl[mid].ad >= ad_raw))
        {
            lo = mid;
        }
        else
        {
            hi = mid;
        }
    }

    /// 线性插值
    ad1 = (int32_t)tbl[lo].ad;
    ad2 = (int32_t)tbl[hi].ad;
    t1 = (int32_t)tbl[lo].temp_x10;
    t2 = (int32_t)tbl[hi].temp_x10;
    ad = (int32_t)ad_raw;

    delta_ad = ad2 - ad1;

    if (delta_ad == 0)
    {
        *temp_x10 = (int16_t)t1;
        return NTC_OK;
    }

    /// T = T1 + (T2 - T1) * (AD - AD1) / (AD2 - AD1)
    *temp_x10 = (int16_t)(t1 + (t2 - t1) * (ad - ad1) / delta_ad);

    return NTC_OK;
}

int8_t ntc_get_temp(struct ntc_handle_t *h, uint16_t adc_raw, int16_t *temp_x10)
{
    if (h == NULL || temp_x10 == NULL || !h->_initialized)
    {
        return NTC_ERR_NULL;
    }

    /// ── 2. ADC 边界检查
    if (adc_raw == 0 || adc_raw >= h->adc_max)
    {
        *temp_x10 = NTC_TEMP_INVALID;
        return NTC_ERR_ADC_RANGE;
    }

    return ntc_ad_to_temp(h, adc_raw, temp_x10);
}